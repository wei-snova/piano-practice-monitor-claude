## main/Kconfig.projbuild
```kconfig
menu "Practice Logger"

    config PL_WIFI_SSID
        string "Wi-Fi SSID (leave empty to run offline)"
        default ""
        help
            Wi-Fi sets the clock (needed to split totals into days) and lets you
            download the session log from http://<board-ip>/.

    config PL_WIFI_PASSWORD
        string "Wi-Fi password"
        default ""

    config PL_TIMEZONE
        string "POSIX time zone"
        default "PST8PDT,M3.2.0,M11.1.0"
        help
            Pacific time by default. Examples:
              US Eastern  EST5EDT,M3.2.0,M11.1.0
              UK          GMT0BST,M3.5.0/1,M10.5.0
              Central EU  CET-1CEST,M3.5.0,M10.5.0/3
              China       CST-8

    config PL_DAILY_GOAL_MIN
        int "Daily practice goal (minutes)"
        default 30
        range 1 600

    config PL_START_HOLD_S
        int "Seconds of playing before a session starts"
        default 5
        range 2 60

    config PL_STOP_GAP_S
        int "Seconds of silence that end a session"
        default 90
        range 15 900
        help
            Pauses shorter than this (page turns, re-tuning, a quick break)
            stay inside the session. The trailing silence is not counted.

    config PL_MIN_SESSION_S
        int "Minimum session length to log (seconds)"
        default 60
        range 0 900

    config PL_CORRECT_WINDOW_MIN
        int "Minutes after a session during which its instrument can be corrected"
        default 15
        range 1 240
        help
            Instrument detection is automatic. If it got a session wrong, tap the
            other instrument on the screen within this time; the board fixes the
            log and learns from the correction.

    config PL_MIC_GAIN_DB
        int "Microphone gain (dB)"
        default 30
        range 0 37
        help
            Lower this if the level meter sits near full while you play.

endmenu
```

## sdkconfig.defaults
```kconfig
CONFIG_IDF_TARGET="esp32s3"

# Flash / partitions (8 MB is safe on 8 MB and 16 MB modules)
CONFIG_ESPTOOLPY_FLASHMODE_QIO=y
CONFIG_ESPTOOLPY_FLASHSIZE_8MB=y
CONFIG_PARTITION_TABLE_CUSTOM=y
CONFIG_PARTITION_TABLE_CUSTOM_FILENAME="partitions.csv"

# CPU / RTOS
CONFIG_ESP_DEFAULT_CPU_FREQ_MHZ_240=y
CONFIG_FREERTOS_HZ=1000
CONFIG_ESP_MAIN_TASK_STACK_SIZE=8192

# Octal PSRAM, tuned for the 16-bit RGB panel
CONFIG_SPIRAM=y
CONFIG_SPIRAM_MODE_OCT=y
CONFIG_SPIRAM_SPEED_80M=y
CONFIG_SPIRAM_XIP_FROM_PSRAM=y
CONFIG_ESP32S3_DATA_CACHE_64KB=y
CONFIG_ESP32S3_DATA_CACHE_LINE_64B=y
CONFIG_ESP32S3_INSTRUCTION_CACHE_32KB=y
CONFIG_LCD_RGB_RESTART_IN_VSYNC=y

# BSP
CONFIG_BSP_SPIFFS_FORMAT_ON_MOUNT_FAIL=y

# LVGL
CONFIG_LV_COLOR_DEPTH_16=y
CONFIG_LV_USE_CLIB_MALLOC=y
CONFIG_LV_USE_CLIB_STRING=y
CONFIG_LV_USE_CLIB_SPRINTF=y
CONFIG_LV_FONT_MONTSERRAT_14=y
CONFIG_LV_FONT_MONTSERRAT_20=y
CONFIG_LV_FONT_MONTSERRAT_48=y
CONFIG_LV_FONT_DEFAULT_MONTSERRAT_14=y
CONFIG_LV_USE_CHART=y
CONFIG_LV_USE_BUTTONMATRIX=y
CONFIG_LV_USE_SLIDER=y
CONFIG_LV_USE_BAR=y

# HTTP
CONFIG_HTTPD_MAX_REQ_HDR_LEN=1024
```
